#include <stddef.h>
#include <GUI.h>
#include <DIALOG.h>
#include "interface.h" 

#include "WM.h"
#include "BUTTON.h"
#include "CHECKBOX.h"
#include "DROPDOWN.h"
#include "EDIT.h"
#include "FRAMEWIN.h"
#include "LISTBOX.h"
#include "MULTIEDIT.h"
#include "RADIO.h"
#include "SLIDER.h"
#include "TEXT.h"
#include "LCDConf.h"
#include "PROGBAR.h"
#include "SCROLLBAR.h"
#include "LISTVIEW.h"
#include "bp_config.h"
WM_HWIN  _hDialogMain,_hDialogControl,_hDialogPower;
#define refvalue 3.3
   
//BMP LOGO

static GUI_CONST_STORAGE unsigned short acnewlogo80[] = {
  0xFFFE, 0xFFDF, 0xFFFF, 0xF7FF, 0xFFFF, 0xFFFF, 0xFFFF, 0xFFFF, 0xFFFE, 0xE6B6, 0xC486, 0xB3A0, 0xB3A0, 0xB3A0, 0xB380, 0xB380, 0xB380, 0xB3A0, 0xB3A0, 0xB380, 0xB380, 0xB380, 0xB380, 0xAB60, 0xAB60, 0xAB60, 0xB360, 0xB360, 0xAB60, 0xAB60, 0xAB60, 
        0xAB40, 0xA320, 0xAB40, 0xAB40, 0xAB60, 0xAB60, 0xA340, 0xA340, 0xAB60, 0xAB40, 0xAB40, 0xAB60, 0xAB60, 0xAB40, 0xAB20, 0xAB40, 0xAB40, 0xA320, 0xAB20, 0xAB40, 0xAB40, 0xAB60, 0xAB40, 0xAB60, 0xAB60, 0xA340, 0xA340, 0xA340, 0xA340, 0xA340, 
        0xA320, 0xAB40, 0xAB40, 0xA340, 0xAB20, 0xAB20, 0xAB00, 0xA300, 0xB340, 0xDD4E, 0xEF3B, 0xFFFF, 0xFFFF, 0xFFFF, 0xF7FF, 0xFFFF, 0xFFDF, 0xFFFF, 0xFFFF,
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        0x79A1, 0x79A0, 0x79C1, 0x79A0, 0x81C1, 0x79A0, 0x79E1, 0xCD0D, 0x8A84, 0x79E2, 0x9B69, 0xCD73, 0xF79E, 0xFFFF, 0xFFFF, 0xFFFF, 0xFFFF, 0xFFFF, 0xFFFF
};

GUI_CONST_STORAGE GUI_BITMAP bmnewlogo80 = {
  80, /* XSize */
  80, /* YSize */
  160, /* BytesPerLine */
  16, /* BitsPerPixel */
  (unsigned char *)acnewlogo80,  /* Pointer to picture data */
  NULL  /* Pointer to palette */
 ,GUI_DRAW_BMP565
};


//EndofEventsFunctionList

//主窗口
/*********************************************************************
*
*       static data
*
**********************************************************************
*/

#define GUI_ID_DS_DY   GUI_ID_USER+100+1
#define GUI_ID_DS_DL   GUI_ID_USER+100+2
#define GUI_ID_BUTTON_DS   GUI_ID_USER+100+3
#define GUI_ID_SJ_DY   GUI_ID_USER+100+4
#define GUI_ID_SJ_DL   GUI_ID_USER+100+5
#define GUI_ID_BUTTON_SJ   GUI_ID_USER+100+6
#define GUI_ID_LX_DY   GUI_ID_USER+100+7
#define GUI_ID_LX_DL   GUI_ID_USER+100+8
#define GUI_ID_BUTTON_LX   GUI_ID_USER+100+9
#define GUI_ID_KZ_DY   GUI_ID_USER+100+10
#define GUI_ID_BUTTON_KZ   GUI_ID_USER+100+11
#define GUI_ID_BUTTON_KZ_FS   GUI_ID_USER+100+12
#define GUI_ID_BUTTON_GL   GUI_ID_USER+100+13
#define GUI_ID_EDIT_GL   GUI_ID_USER+100+14


/*********************************************************************
*
*       Dialog resource
*
*		主窗口，为显示的主界面
*/

static const GUI_WIDGET_CREATE_INFO _MainDialogCreate[] = {
    { FRAMEWIN_CreateIndirect,  "Caption",           0,                       0,  0,  420,272,0,0},
    { CHECKBOX_CreateIndirect,  "灯丝1",                GUI_ID_CHECK0,           10, 21, 50, 17, 0,0},
    { CHECKBOX_CreateIndirect,  "过流",                GUI_ID_CHECK1,           63, 20, 62, 19, 0,0},
    { TEXT_CreateIndirect,      "电压",                GUI_ID_TEXT1,            10, 49, 39, 18, 0,0},
    { TEXT_CreateIndirect,      "电流",                GUI_ID_TEXT2,            8,  82, 39, 18, 0,0},
    { EDIT_CreateIndirect,      "1.2",               GUI_ID_DS_DY,            45, 42, 80, 25, 0,0},
    { EDIT_CreateIndirect,       NULL,               GUI_ID_DS_DL,            45, 75, 80, 25, 0,0},
    { BUTTON_CreateIndirect,    "打开",                GUI_ID_BUTTON_DS,        35, 104,100, 30, 0,0},
    { EDIT_CreateIndirect,       NULL,               GUI_ID_SJ_DY,            183,42, 80, 25, 0,0},
    { EDIT_CreateIndirect,       NULL,               GUI_ID_SJ_DL,            183,75, 80, 25, 0,0},
    { BUTTON_CreateIndirect,    "打开",                GUI_ID_BUTTON_SJ,        173,104,100, 30, 0,0},
    { EDIT_CreateIndirect,       NULL,               GUI_ID_LX_DY,            323,42, 80, 25, 0,0},
    { EDIT_CreateIndirect,       NULL,               GUI_ID_LX_DL,            323,75, 80, 25, 0,0},
    { BUTTON_CreateIndirect,    "打开",                GUI_ID_BUTTON_LX,        313,104,100, 30, 0,0},
    { TEXT_CreateIndirect,      "电压",                GUI_ID_TEXT1,            10, 179,37, 18, 0,0},
    { EDIT_CreateIndirect,       NULL,               GUI_ID_KZ_DY,            47, 172,80, 25, 0,0},
    { BUTTON_CreateIndirect,    "打开",                GUI_ID_BUTTON_KZ,        143,172,100, 30, 0,0},
    { BUTTON_CreateIndirect,    "发射",                GUI_ID_BUTTON_KZ_FS,     270,172,100, 30, 0,0},
    { BUTTON_CreateIndirect,    "功率设置",              GUI_ID_BUTTON_GL,        133,208,80, 25, 0,0},
    { TEXT_CreateIndirect,      "功率",                GUI_ID_TEXT5,            10, 215,37, 18, 0,0},
    { EDIT_CreateIndirect,      "3.12",              GUI_ID_EDIT_GL,          47, 208,100, 52, 0,0},
    { TEXT_CreateIndirect,      "电压",                GUI_ID_TEXT1,            146,49, 37, 18, 0,0},
    { TEXT_CreateIndirect,      "电流",                GUI_ID_TEXT2,            148,82, 35, 18, 0,0},
    { TEXT_CreateIndirect,      "电压",                GUI_ID_TEXT1,            283,49, 39, 18, 0,0},
    { TEXT_CreateIndirect,      "电流",                GUI_ID_TEXT2,            283,82, 39, 18, 0,0},
    { CHECKBOX_CreateIndirect,  "灯丝2",                GUI_ID_CHECK2,           143,21, 58, 17, 0,0},
    { CHECKBOX_CreateIndirect,  "过流",                GUI_ID_CHECK3,           208,21, 60, 19, 0,0},
    { CHECKBOX_CreateIndirect,  "灯丝3",                GUI_ID_CHECK4,           278,22, 58, 17, 0,0},
    { CHECKBOX_CreateIndirect,  "过流",                GUI_ID_CHECK5,           342,22, 66, 19, 0,0},
    { CHECKBOX_CreateIndirect,  "控制",                GUI_ID_CHECK6,           10, 147,49, 17, 0,0},
    { CHECKBOX_CreateIndirect,  "发射",                GUI_ID_CHECK7,           62, 147,63, 19, 0,0}
};

/*****************************************************************
**      FunctionName:void PaintDialog(WM_MESSAGE * pMsg)
**      Function: to initialize the Dialog items
**                                                      
**      call this function in _cbCallback --> WM_PAINT
*****************************************************************/

void MainPaintDialog(WM_MESSAGE * pMsg)
{
    WM_HWIN hWin = pMsg->hWin;

}
/*****************************************************************
**      FunctionName:void InitDialog(WM_MESSAGE * pMsg)
**      Function: to initialize the Dialog items
**                                                      
**      call this function in _cbCallback --> WM_INIT_DIALOG
*****************************************************************/

void MainInitDialog(WM_MESSAGE * pMsg)
{
    WM_HWIN hWin = pMsg->hWin;
    //
    //FRAMEWIN
    //
	//FRAMEWIN_SetFont(hWin,&GUI_FontHZ_SimSun_16);
    FRAMEWIN_SetClientColor(hWin,0xc0c0c0);
    FRAMEWIN_SetTextColor(hWin,0x000000);
    FRAMEWIN_SetTitleVis(hWin,0);
    //
    //GUI_ID_CHECK0
    //

    CHECKBOX_SetText(WM_GetDialogItem(hWin,GUI_ID_CHECK0),"灯丝");



    //
    //GUI_ID_CHECK1
    //
    CHECKBOX_SetText(WM_GetDialogItem(hWin,GUI_ID_CHECK1),"过流");
    CHECKBOX_SetBkColor(WM_GetDialogItem(hWin,GUI_ID_CHECK1),0xc0c0c0);
    //
    //GUI_ID_TEXT1
    //
    TEXT_SetBkColor(WM_GetDialogItem(hWin,GUI_ID_TEXT1),0xc0c0c0);
    //
    //GUI_ID_TEXT2
    //
    TEXT_SetBkColor(WM_GetDialogItem(hWin,GUI_ID_TEXT2),0xc0c0c0);
    //
    //GUI_ID_BUTTON_DS
    //
    BUTTON_SetBkColor(WM_GetDialogItem(hWin,GUI_ID_BUTTON_DS),BUTTON_CI_UNPRESSED,0xc0c0c0);
    //
    //GUI_ID_BUTTON_SJ
    //
    BUTTON_SetBkColor(WM_GetDialogItem(hWin,GUI_ID_BUTTON_SJ),BUTTON_CI_UNPRESSED,0xc0c0c0);
    //
    //GUI_ID_BUTTON_LX
    //
    BUTTON_SetBkColor(WM_GetDialogItem(hWin,GUI_ID_BUTTON_LX),BUTTON_CI_UNPRESSED,0xc0c0c0);
    //
    //GUI_ID_TEXT1
    //
    TEXT_SetBkColor(WM_GetDialogItem(hWin,GUI_ID_TEXT1),0xc0c0c0);

    //
    //GUI_ID_BUTTON_KZ
    //
    BUTTON_SetBkColor(WM_GetDialogItem(hWin,GUI_ID_BUTTON_KZ),BUTTON_CI_UNPRESSED,0xc0c0c0);
    //
    //GUI_ID_BUTTON_KZ_FS
    //
    BUTTON_SetBkColor(WM_GetDialogItem(hWin,GUI_ID_BUTTON_KZ_FS),BUTTON_CI_UNPRESSED,0xc0c0c0);
    WM_DisableWindow(WM_GetDialogItem(hWin,GUI_ID_BUTTON_KZ_FS));
    //
    //GUI_ID_BUTTON_GL
    //
    BUTTON_SetBkColor(WM_GetDialogItem(hWin,GUI_ID_BUTTON_GL),BUTTON_CI_UNPRESSED,0xc0c0c0);
    //
    //GUI_ID_TEXT5
    //
    TEXT_SetBkColor(WM_GetDialogItem(hWin,GUI_ID_TEXT5),0xc0c0c0);
    //
    //GUI_ID_EDIT_GL
    //
    //EDIT_SetBkColor(WM_GetDialogItem(hWin,GUI_ID_EDIT_GL),0,0xdf967a);
    //
    //GUI_ID_TEXT1
    //
    TEXT_SetBkColor(WM_GetDialogItem(hWin,GUI_ID_TEXT1),0xc0c0c0);
    //
    //GUI_ID_TEXT2
    //
    TEXT_SetBkColor(WM_GetDialogItem(hWin,GUI_ID_TEXT2),0xc0c0c0);
    //
    //GUI_ID_TEXT1
    //
    TEXT_SetBkColor(WM_GetDialogItem(hWin,GUI_ID_TEXT1),0xc0c0c0);
    //
    //GUI_ID_TEXT2
    //
    TEXT_SetBkColor(WM_GetDialogItem(hWin,GUI_ID_TEXT2),0xc0c0c0);
    //
    //GUI_ID_CHECK2
    //
    CHECKBOX_SetText(WM_GetDialogItem(hWin,GUI_ID_CHECK2),"灯丝2");
    CHECKBOX_SetBkColor(WM_GetDialogItem(hWin,GUI_ID_CHECK2),0xc0c0c0);
    //
    //GUI_ID_CHECK3
    //
    CHECKBOX_SetText(WM_GetDialogItem(hWin,GUI_ID_CHECK3),"过流");
    CHECKBOX_SetBkColor(WM_GetDialogItem(hWin,GUI_ID_CHECK3),0xc0c0c0);

    //
    //GUI_ID_CHECK4
    //
    CHECKBOX_SetText(WM_GetDialogItem(hWin,GUI_ID_CHECK4),"灯丝3");
    CHECKBOX_SetBkColor(WM_GetDialogItem(hWin,GUI_ID_CHECK4),0xc0c0c0);
//		CHECKBOX_SetFont(WM_GetDialogItem(hWin,GUI_ID_CHECK4),&GUI_FontHZ_SimSun_16);
    //
    //GUI_ID_CHECK5
    //
    CHECKBOX_SetText(WM_GetDialogItem(hWin,GUI_ID_CHECK5),"过流");
    CHECKBOX_SetBkColor(WM_GetDialogItem(hWin,GUI_ID_CHECK5),0xc0c0c0);
    //
    //GUI_ID_CHECK6
    //
    CHECKBOX_SetText(WM_GetDialogItem(hWin,GUI_ID_CHECK6),"控制");
    CHECKBOX_SetBkColor(WM_GetDialogItem(hWin,GUI_ID_CHECK6),0xc0c0c0);


    //
    //GUI_ID_CHECK7
    //
    CHECKBOX_SetText(WM_GetDialogItem(hWin,GUI_ID_CHECK7),"发射");
    CHECKBOX_SetBkColor(WM_GetDialogItem(hWin,GUI_ID_CHECK7),0xc0c0c0);

	WM_DisableWindow(WM_GetDialogItem(hWin,GUI_ID_CHECK0));
	WM_DisableWindow(WM_GetDialogItem(hWin,GUI_ID_CHECK7));
	WM_DisableWindow(WM_GetDialogItem(hWin,GUI_ID_CHECK6));
	WM_DisableWindow(WM_GetDialogItem(hWin,GUI_ID_CHECK5));
	WM_DisableWindow(WM_GetDialogItem(hWin,GUI_ID_CHECK4));
	WM_DisableWindow(WM_GetDialogItem(hWin,GUI_ID_CHECK3));
	WM_DisableWindow(WM_GetDialogItem(hWin,GUI_ID_CHECK2));
	WM_DisableWindow(WM_GetDialogItem(hWin,GUI_ID_CHECK1));
	WM_HideWindow(WM_GetDialogItem(hWin,GUI_ID_BUTTON_GL));
	
	EDIT_SetFont(WM_GetDialogItem(hWin,GUI_ID_EDIT_GL),&GUI_FontD36x48);	//	 &GUI_FontD80
	//CHECKBOX_SetBkColor(WM_GetDialogItem(hWin,GUI_ID_CHECK0),GUI_WHITE);
   // CHECKBOX_SetBkColor(WM_GetDialogItem(hWin,GUI_ID_CHECK0),GUI_WHITE);

}




/*********************************************************************
*
*       主窗口回调函数 Dialog callback routine
*/
static void _MainCallback(WM_MESSAGE * pMsg) 
{
    int NCode, Id;
    WM_HWIN hWin = pMsg->hWin;
    switch (pMsg->MsgId) 
    {
        case WM_PAINT:
            MainPaintDialog(pMsg);
            break;
        case WM_INIT_DIALOG:
            MainInitDialog(pMsg);
            break;
        case WM_KEY:
            switch (((WM_KEY_INFO*)(pMsg->Data.p))->Key) 
            {
                case GUI_KEY_ESCAPE:
                    GUI_EndDialog(hWin, 1);
                    break;
                case GUI_KEY_ENTER:
                    GUI_EndDialog(hWin, 0);
                    break;
            }
            break;
        case WM_NOTIFY_PARENT:
            Id = WM_GetId(pMsg->hWinSrc); 
            NCode = pMsg->Data.v;        
            switch (Id) 
            {

                case GUI_ID_BUTTON_DS:
                    switch(NCode)
                    {
                        case WM_NOTIFICATION_CLICKED:
                            OnMainDSClicked(pMsg);
                            break;
                    }
                    break;
                case GUI_ID_BUTTON_SJ:
                    switch(NCode)
                    {
                        case WM_NOTIFICATION_CLICKED:
                            OnMainSJClicked(pMsg);
                            break;
                    }
                    break;
                case GUI_ID_BUTTON_LX:
                    switch(NCode)
                    {
                        case WM_NOTIFICATION_CLICKED:
                            OnMainLXClicked(pMsg);
                            break;
                    }
                    break;
                case GUI_ID_BUTTON_KZ:
                    switch(NCode)
                    {
                        case WM_NOTIFICATION_CLICKED:
                            OnMainKZClicked(pMsg);
                            break;
                    }
                    break;
                case GUI_ID_BUTTON_KZ_FS:
                    switch(NCode)
                    {
                        case WM_NOTIFICATION_CLICKED:
                            OnMainFSClicked(pMsg);
                            break;
                    }
                    break;
                case GUI_ID_BUTTON_GL:
                    switch(NCode)
                    {
                        case WM_NOTIFICATION_CLICKED:
                            OnMainPowerClicked(pMsg);
                            break;
                    }
                    break;

            }
            break;
        default:
            WM_DefaultProc(pMsg);
    }
}

void OnMainDSClicked(WM_MESSAGE * pMsg)

{
    WM_HWIN hWin = pMsg->hWin;
	if (get_ds_state())
	{
		set_ds_close();
		CHECKBOX_Uncheck(WM_GetDialogItem(hWin,GUI_ID_CHECK0));				
       BUTTON_SetBkColor(WM_GetDialogItem(hWin,GUI_ID_BUTTON_DS),BUTTON_CI_UNPRESSED,0xc0c0c0);
	
	}else
	{
		set_ds_open();
		CHECKBOX_Check(WM_GetDialogItem(hWin,GUI_ID_CHECK0));

    	BUTTON_SetBkColor(WM_GetDialogItem(hWin,GUI_ID_BUTTON_DS),BUTTON_CI_UNPRESSED,GUI_GREEN);		
	}

}
void OnMainSJClicked(WM_MESSAGE * pMsg)
{
	WM_HWIN hWin = pMsg->hWin;
	if (get_sj_state())
	{
		set_sj_close();
		CHECKBOX_Uncheck(WM_GetDialogItem(hWin,GUI_ID_CHECK2));				
       BUTTON_SetBkColor(WM_GetDialogItem(hWin,GUI_ID_BUTTON_SJ),BUTTON_CI_UNPRESSED,0xc0c0c0);
	
	}else
	{
		set_sj_open();
		CHECKBOX_Check(WM_GetDialogItem(hWin,GUI_ID_CHECK2));			

    	BUTTON_SetBkColor(WM_GetDialogItem(hWin,GUI_ID_BUTTON_SJ),BUTTON_CI_UNPRESSED,GUI_GREEN);
	}
}
void OnMainLXClicked(WM_MESSAGE * pMsg)
{
	WM_HWIN hWin = pMsg->hWin;
	if (get_lx_state())
	{
		set_lx_close();
		CHECKBOX_Uncheck(WM_GetDialogItem(hWin,GUI_ID_CHECK4));				
       BUTTON_SetBkColor(WM_GetDialogItem(hWin,GUI_ID_BUTTON_LX),BUTTON_CI_UNPRESSED,0xc0c0c0);
	
	}else
	{
		set_lx_open();
		CHECKBOX_Check(WM_GetDialogItem(hWin,GUI_ID_CHECK4));			

    	BUTTON_SetBkColor(WM_GetDialogItem(hWin,GUI_ID_BUTTON_LX),BUTTON_CI_UNPRESSED,GUI_GREEN);
	}
}
void OnMainKZClicked(WM_MESSAGE * pMsg)
{
	WM_HWIN hWin = pMsg->hWin;
	if (get_kz_state())
	{
		set_kz_close();
		WM_DisableWindow(WM_GetDialogItem(hWin,GUI_ID_BUTTON_KZ_FS));
		CHECKBOX_Uncheck(WM_GetDialogItem(hWin,GUI_ID_CHECK6));	
        BUTTON_SetBkColor(WM_GetDialogItem(hWin,GUI_ID_BUTTON_KZ),BUTTON_CI_UNPRESSED,0xc0c0c0);
					
	
	}else
	{
		set_kz_open();
		WM_EnableWindow(WM_GetDialogItem(hWin,GUI_ID_BUTTON_KZ_FS));
		CHECKBOX_Check(WM_GetDialogItem(hWin,GUI_ID_CHECK6));			
    	BUTTON_SetBkColor(WM_GetDialogItem(hWin,GUI_ID_BUTTON_KZ),BUTTON_CI_UNPRESSED,GUI_GREEN);//0xc0c0c0);

	}
}
void OnMainFSClicked(WM_MESSAGE * pMsg)
{
 	WM_HWIN hWin = pMsg->hWin;
	if (get_fs_state())
	{
		set_fs_close();
		CHECKBOX_Uncheck(WM_GetDialogItem(hWin,GUI_ID_CHECK7));				
    	BUTTON_SetBkColor(WM_GetDialogItem(hWin,GUI_ID_BUTTON_KZ_FS),BUTTON_CI_UNPRESSED,0xc0c0c0);
		WM_EnableWindow(WM_GetDialogItem(hWin,GUI_ID_BUTTON_KZ));
	
	}else
	{
		set_fs_open();
		CHECKBOX_Check(WM_GetDialogItem(hWin,GUI_ID_CHECK7));			
    	BUTTON_SetBkColor(WM_GetDialogItem(hWin,GUI_ID_BUTTON_KZ_FS),BUTTON_CI_UNPRESSED,GUI_GREEN);//0xc0c0c0);
		WM_DisableWindow(WM_GetDialogItem(hWin,GUI_ID_BUTTON_KZ));

	}

}
void OnMainPowerClicked(WM_MESSAGE * pMsg)
{
}


/*********************end of main window**********************/


/*********************************************************************
*
*       控制窗口 static data
*
**********************************************************************
*/

#define GUI_ID_B_DISPALL   GUI_ID_USER+201
#define GUI_ID_B_POWER   GUI_ID_USER+202
#define GUI_ID_B_CLOSE   GUI_ID_USER+203


/*********************************************************************
*
*       Dialog resource
*
* This table conatins the info required to create the dialog.
* It has been created by ucGUIbuilder.
*/

static const GUI_WIDGET_CREATE_INFO _ControlDialogCreate[] = {
    { FRAMEWIN_CreateIndirect,  "CONTROL",           0,                       0,  0,  80, 272,0,0},
    { BUTTON_CreateIndirect,    "全部",                GUI_ID_B_DISPALL,        8,  24, 48, 48, 0,0},
    { BUTTON_CreateIndirect,    "功率",                GUI_ID_B_POWER,          8,  112,48, 48, 0,0},
    { BUTTON_CreateIndirect,    "关机",                GUI_ID_B_CLOSE,          8,  202,48, 48, 0,0}
};



/*****************************************************************
**      FunctionName:void PaintDialog(WM_MESSAGE * pMsg)
**      Function: to initialize the Dialog items
**                                                      
**      call this function in _cbCallback --> WM_PAINT
*****************************************************************/

void ControlPaintDialog(WM_MESSAGE * pMsg)
{
    WM_HWIN hWin = pMsg->hWin;

}



/*****************************************************************
**      FunctionName:void InitDialog(WM_MESSAGE * pMsg)
**      Function: to initialize the Dialog items
**                                                      
**      call this function in _cbCallback --> WM_INIT_DIALOG
*****************************************************************/

void ControlInitDialog(WM_MESSAGE * pMsg)
{
    WM_HWIN hWin = pMsg->hWin;
    //
    //FRAMEWIN
    //
    FRAMEWIN_SetTitleVis(hWin,0);
    //
    //GUI_ID_B_DISPALL
    //
    //
    //GUI_ID_B_POWER
    //
    BUTTON_SetTextColor(WM_GetDialogItem(hWin,GUI_ID_B_POWER),BUTTON_CI_UNPRESSED,0x2a2aa5);
    //
    //GUI_ID_B_CLOSE
    //
    BUTTON_SetTextColor(WM_GetDialogItem(hWin,GUI_ID_B_CLOSE),BUTTON_CI_UNPRESSED,0x2a2aa5);


    	BUTTON_SetBkColor(WM_GetDialogItem(hWin,GUI_ID_B_DISPALL),BUTTON_CI_UNPRESSED,GUI_GREEN);
    	BUTTON_SetBkColor(WM_GetDialogItem(hWin,GUI_ID_B_POWER),BUTTON_CI_UNPRESSED,GUI_BLUE);
    	BUTTON_SetBkColor(WM_GetDialogItem(hWin,GUI_ID_B_CLOSE),BUTTON_CI_UNPRESSED,GUI_YELLOW);

	

}




/*********************************************************************
*
*       Dialog callback routine
*/
static void _ControlCallback(WM_MESSAGE * pMsg) 
{
    int NCode, Id;
    WM_HWIN hWin = pMsg->hWin;
    switch (pMsg->MsgId) 
    {
        case WM_PAINT:
            ControlPaintDialog(pMsg);
            break;
        case WM_INIT_DIALOG:
            ControlInitDialog(pMsg);
            break;
        case WM_KEY:
            switch (((WM_KEY_INFO*)(pMsg->Data.p))->Key) 
            {
                case GUI_KEY_ESCAPE:
                    GUI_EndDialog(hWin, 1);
                    break;
                case GUI_KEY_ENTER:
                    GUI_EndDialog(hWin, 0);
                    break;
            }
            break;
        case WM_NOTIFY_PARENT:
            Id = WM_GetId(pMsg->hWinSrc); 
            NCode = pMsg->Data.v;        
            switch (Id) 
            {
                case GUI_ID_B_POWER:
                    if(NCode==WM_NOTIFICATION_RELEASED)
                        ON_DISPPOWER_CLICKED();
                    break;
                case GUI_ID_B_DISPALL :
                    if(NCode==WM_NOTIFICATION_RELEASED)
                        ON_DISPALL_CLICKED();
                    break;
				
            }
            break;
        default:
            WM_DefaultProc(pMsg);
    }
}

void ON_DISPPOWER_CLICKED()
{
    WM_ShowWindow(_hDialogPower);
	WM_HideWindow(_hDialogMain);

}
void ON_DISPALL_CLICKED()
{
    WM_ShowWindow(_hDialogMain);
	WM_HideWindow(_hDialogPower);

}


/*********************************************************************
*
*       static data
*
**********************************************************************
*/

#define GUI_ID_BUTTON_GLBIG   GUI_ID_USER+206
#define GUI_ID_EDIT_GLBIG   GUI_ID_USER+207
#define  GUI_ID_TEXT_GLBIG  GUI_ID_USER+208
#define GUI_ID_TEXT_GL	   GUI_ID_USER+209

/*********************************************************************
*
*       功率窗口
*
* This table conatins the info required to create the dialog.
* It has been created by ucGUIbuilder.
*/

static const GUI_WIDGET_CREATE_INFO _PowerDialogCreate[] = {
    { FRAMEWIN_CreateIndirect,  "",           0,        0,  0,  420,272,0,0},
    //{ BUTTON_CreateIndirect,    "功率设置",              GUI_ID_BUTTON_GL,        299,87, 92, 86, 0,0},
    { TEXT_CreateIndirect,      "功率:",                GUI_ID_TEXT_GL,            150, 60, 400,120, 0,0}
    //{ EDIT_CreateIndirect,      "2.51",              GUI_ID_EDIT_GLBIG,          15, 60, 400,120, 0,0}
};



/*****************************************************************
**      FunctionName:void PaintDialog(WM_MESSAGE * pMsg)
**      Function: to initialize the Dialog items
**                                                      
**      call this function in _cbCallback --> WM_PAINT
*****************************************************************/

void PowerPaintDialog(WM_MESSAGE * pMsg)
{
    //WM_HWIN hWin = pMsg->hWin;
	OnMainPowerClicked(pMsg);
}



/*****************************************************************
**      FunctionName:void InitDialog(WM_MESSAGE * pMsg)
**      Function: to initialize the Dialog items
**                                                      
**      call this function in _cbCallback --> WM_INIT_DIALOG
*****************************************************************/

void PowerInitDialog(WM_MESSAGE * pMsg)
{
    WM_HWIN hWin = pMsg->hWin;
    //
    //FRAMEWIN
    //
    //
    //GUI_ID_TEXT5
    //
    //TEXT_SetFont(WM_GetDialogItem(hWin,GUI_ID_TEXTGLBIG),&GUI_FontD24x32);
    //
    //GUI_ID_EDIT_GL
    //
	FRAMEWIN_SetTitleVis(hWin,0);
   // TEXT_SetBkColor(WM_GetDialogItem(hWin,GUI_ID_TEXT_GL),0xdf967a);
    TEXT_SetFont(WM_GetDialogItem(hWin,GUI_ID_TEXT_GL),&GUI_FontD80);

}




/*********************************************************************
*
*       Dialog callback routine
*/
static void _PowerCallback(WM_MESSAGE * pMsg) 
{
    int NCode, Id;
    WM_HWIN hWin = pMsg->hWin;
    switch (pMsg->MsgId) 
    {
        case WM_PAINT:
            PowerPaintDialog(pMsg);
            break;
        case WM_INIT_DIALOG:
            PowerInitDialog(pMsg);
            break;
        case WM_KEY:
            switch (((WM_KEY_INFO*)(pMsg->Data.p))->Key) 
            {
                case GUI_KEY_ESCAPE:
                    GUI_EndDialog(hWin, 1);
                    break;
                case GUI_KEY_ENTER:
                    GUI_EndDialog(hWin, 0);
                    break;
            }
            break;
        case WM_NOTIFY_PARENT:
            Id = WM_GetId(pMsg->hWinSrc); 
            NCode = pMsg->Data.v;        
            switch (Id) 
            {
                case GUI_ID_OK:
                    if(NCode==WM_NOTIFICATION_RELEASED)
                        GUI_EndDialog(hWin, 0);
                    break;
                case GUI_ID_CANCEL:
                    if(NCode==WM_NOTIFICATION_RELEASED)
                        GUI_EndDialog(hWin, 0);
                    break;
                case GUI_ID_BUTTON_GLBIG:
                    switch(NCode)
                    {
                        case WM_NOTIFICATION_CLICKED:
                            OnPowerSetClicked(pMsg);
                            break;
                    }
                    break;

            }
            break;
        default:
            WM_DefaultProc(pMsg);
    }
}
void OnPowerSetClicked(WM_MESSAGE * pMsg)
{
	;
}

/*介绍窗口*/

/* Text shown in the intro dialog */
static const char * _apIntro[] = {
  "This application made by BrightPoint",
  "2012 for BrightPoint Stm32 Develop Board",
  "To start the applicationplease press the <Start> button...",
};

/* Resource for intro */
static const GUI_WIDGET_CREATE_INFO _aIntro[] = {
  { WINDOW_CreateIndirect,    "",             0,                    0,   0, LCD_XSIZE, LCD_YSIZE, 0},
  { BUTTON_CreateIndirect,    "Start",        GUI_ID_BUTTON0,     LCD_XSIZE/2-50, 200, 100, 20},
};
/*********************************************************************
*
*       _cbIntro
*
* Purpose:
*   Callback routine of intro dialog.
*/
static void _cbIntro(WM_MESSAGE * pMsg) {
  WM_HWIN hDlg;
  GUI_RECT Rect;
  int Id, i, ySizeText, yPos = 20;
  hDlg = pMsg->hWin;
  switch (pMsg->MsgId) {
  case WM_PAINT:
    WM_GetClientRect(&Rect);
    GUI_SetBkColor(GUI_WHITE);
    GUI_SetColor(GUI_BLACK);
    GUI_Clear();
    GUI_DrawBitmap(&bmnewlogo80, (Rect.x1 - bmnewlogo80.XSize) / 2, yPos);
    ySizeText = GUI_GetFontSizeY();
    yPos += bmnewlogo80.YSize + 30;
    for (i = 0; i < GUI_COUNTOF(_apIntro); i++) {
      GUI_DispStringHCenterAt(_apIntro[i], Rect.x1 / 2, yPos);
      yPos += ySizeText;
    }
    break;
  case WM_KEY:
    switch (((WM_KEY_INFO*)(pMsg->Data.p))->Key) {
    case GUI_KEY_ESCAPE:
    case GUI_KEY_ENTER:
      GUI_EndDialog(hDlg, 0);
      break;
    }
    break;
  case WM_NOTIFY_PARENT:
    if (pMsg->Data.v == WM_NOTIFICATION_RELEASED) {
      Id = WM_GetId(pMsg->hWinSrc);      /* Id of widget */
      if (Id == GUI_ID_BUTTON0) {
        GUI_EndDialog(hDlg, 1);
      }
    }
    break;
  default:
    WM_DefaultProc(pMsg);
  }
}



void BP_UCGUI_Task(void) {
   

  WM_HWIN hMainFrame, hClientWindow;
  GUI_RECT Rect;
  GUI_Init();  //GUI 初始化，最先被调用
  //GUI_CURSOR_Show();  //GUI函数,显示游标  
  //GUI_SetFont(&GUI_FontHZ_SimSun_16); //设置字体
  /* Enable use of memory devices (if available) */
  #if GUI_SUPPORT_MEMDEV //使用内存设备
    WM_SetCreateFlags(WM_CF_MEMDEV); 
    WM_EnableMemdev(WM_HBKWIN);
  #endif 
  /* Enable redrawing mechanism for background window */
  WM_SetDesktopColor(GUI_BLACK); //设置背景颜色 黑 在GUI.H中定义
  /* Create and execute the intro dialog */
  //在背景之上，创建并执行第一个对话框
  //GUI_ExecDialogBox(_aIntro, GUI_COUNTOF(_aIntro), _cbIntro, WM_HBKWIN, 0, 0);
  //GUI_ExecDialogBox(_MainDialogCreate, GUI_COUNTOF(_MainDialogCreate), _MainCallback, WM_HBKWIN, 0, 0);
  //按START之后，该窗口关闭
  //Showain();
  
  /* Create main frame window */
  /*创建主帧，480×272*/
  hMainFrame = FRAMEWIN_CreateEx(0, 0, LCD_XSIZE, LCD_YSIZE, 
                                 WM_HBKWIN, WM_CF_SHOW, 0, 0, "", 0);
  FRAMEWIN_SetTextAlign(hMainFrame, GUI_TA_HCENTER);

  hClientWindow = WM_GetClientWindow(hMainFrame); /* 取得主帧窗口的客户窗句柄 */
  WM_GetClientRectEx(hClientWindow, &Rect);       /* 取得该客户窗的位置到Rect*/
  hClientWindow=WM_HBKWIN;
  
  _hDialogMain= 
  GUI_CreateDialogBox(_MainDialogCreate, GUI_COUNTOF(_MainDialogCreate), _MainCallback, hClientWindow, 0, 0);
 _hDialogControl=
  GUI_CreateDialogBox(_ControlDialogCreate, GUI_COUNTOF(_ControlDialogCreate), _ControlCallback, hClientWindow, Rect.x1 - 60, 0);
  _hDialogPower=
  GUI_CreateDialogBox(_PowerDialogCreate, GUI_COUNTOF(_PowerDialogCreate), _PowerCallback, hClientWindow, 0, 0);

  //WM_ShowWindow(_hDialogMain);
  WM_HideWindow(_hDialogPower);

}

void SetMainwindowDispValue(u16 * value)
{
	char buf[8];
	sprintf(buf, "%.2f",*value++*refvalue/4095);
	EDIT_SetText(WM_GetDialogItem(_hDialogMain,GUI_ID_DS_DY),buf);
	sprintf(buf, "%.2f",*value++*refvalue/4095);
	EDIT_SetText(WM_GetDialogItem(_hDialogMain,GUI_ID_DS_DL),buf);
	sprintf(buf, "%.2f",*value++*refvalue/4095);
	EDIT_SetText(WM_GetDialogItem(_hDialogMain,GUI_ID_SJ_DY),buf);
	sprintf(buf, "%.2f",*value++*refvalue/4095);
	EDIT_SetText(WM_GetDialogItem(_hDialogMain,GUI_ID_SJ_DL),buf);
	sprintf(buf, "%.2f",*value++*refvalue/4095);
	EDIT_SetText(WM_GetDialogItem(_hDialogMain,GUI_ID_LX_DY),buf);
	sprintf(buf, "%.2f",*value++*refvalue/4095);
	EDIT_SetText(WM_GetDialogItem(_hDialogMain,GUI_ID_LX_DL),buf);
	sprintf(buf, "%.2f",*value++*refvalue/4095);
	EDIT_SetText(WM_GetDialogItem(_hDialogMain,GUI_ID_KZ_DY),buf);
	if (*value&GETDSGL)
	{		
		CHECKBOX_Check(WM_GetDialogItem(_hDialogMain,GUI_ID_CHECK1));	
        CHECKBOX_SetBkColor(WM_GetDialogItem(_hDialogMain,GUI_ID_CHECK1),GUI_BLUE);
		SetBeepOn();
	}
	else
	{
		CHECKBOX_Uncheck(WM_GetDialogItem(_hDialogMain,GUI_ID_CHECK1));
	    CHECKBOX_SetBkColor(WM_GetDialogItem(_hDialogMain,GUI_ID_CHECK1),0xc0c0c0);

	}	
 	if (*value&GETSJGL)
	{
		CHECKBOX_Check(WM_GetDialogItem(_hDialogMain,GUI_ID_CHECK3));	
        CHECKBOX_SetBkColor(WM_GetDialogItem(_hDialogMain,GUI_ID_CHECK3),GUI_BLUE);
		SetBeepOn();
	}
	else
	{
		CHECKBOX_Uncheck(WM_GetDialogItem(_hDialogMain,GUI_ID_CHECK3));
	    CHECKBOX_SetBkColor(WM_GetDialogItem(_hDialogMain,GUI_ID_CHECK3),0xc0c0c0);

	}	
  	if (*value&GETLXGL)
	{
		CHECKBOX_Check(WM_GetDialogItem(_hDialogMain,GUI_ID_CHECK5));	
        CHECKBOX_SetBkColor(WM_GetDialogItem(_hDialogMain,GUI_ID_CHECK5),GUI_BLUE);
		SetBeepOn();

	}
	else
	{
		CHECKBOX_Uncheck(WM_GetDialogItem(_hDialogMain,GUI_ID_CHECK5));
	    CHECKBOX_SetBkColor(WM_GetDialogItem(_hDialogMain,GUI_ID_CHECK5),0xc0c0c0);
	
	}
	if (*value==0) 	SetBeepOff();

}
/*const float powers[20]={0.165,0.33,0.495,0.66,\
0.825,0.99,1.155,1.32,1.485,\
1.65,1.815,1.98,2.145,2.31,\
2.475,2.64,2.805,2.97,3.135,3.3};	   */

const float powers[21]={0.157,0.314,0.471,0.628,0.785,\
0.943,1.1,1.257,\
1.414285714,\
1.571428571,\
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3.142857143,\
3.3			\
};
 
void SetMainwindowPowerValue(u16 * value1)	 //显示功率
{
	char buf[8];
	float fvalue;
	u8 i;
	u32 setvalue;
	setvalue=0;
	fvalue=*value1*refvalue/4095; 
	
	for(i=0;i<=20;i++)
	{
		if (fvalue<=powers[i])
			break;	
	}//sprintf(buf, "%.2f",);
	sprintf(buf,"%ddbm",i);

	setvalue=0;
    i=20-i;
	if (i&0x10) //位4为1
		setvalue|=G_P_O4;
	else
	    setvalue|=(((u32)G_P_O4)<<16);
	if (i&0x08) //位3为1
		setvalue|=G_P_O3;
	else
	    setvalue|=(((u32)G_P_O3)<<16);
	if (i&0x04) //位2为1
		setvalue|=G_P_O2;
	else
	    setvalue|=(((u32)G_P_O2)<<16);		
	
	if (i&0x02) //位1为1
		setvalue|=G_P_O1;
	else
	    setvalue|=G_P_O1<<16;		
	
	if (i&0x01) //位0为1
		setvalue|=G_P_O0;
	else
	    setvalue|=(((u32)G_P_O0)<<16);	
	//setvalue|=(((u32)1)<<16);			

	GPIO_P->BSRR=setvalue;
	EDIT_SetText(WM_GetDialogItem(_hDialogMain,GUI_ID_EDIT_GL),buf);	
	TEXT_SetText(WM_GetDialogItem(_hDialogPower,GUI_ID_TEXT_GL),buf);
}